#include "sosho_L.dtsi"

&spi1 { status = "okay"; };
&trackball{ status = "okay"; };
&tracball_listener {
    status = "okay";
    input-processors = <&zip_xy_to_scroll_mapper>
};
&trackball_split{
    status = "okay";
    device = <&trackball>;
};